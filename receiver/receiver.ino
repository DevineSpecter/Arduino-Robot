
/*-----( Import needed libraries )-----*/
#include <SPI.h>
#include <nRF24L01.h>
#include <RF24.h>
/*-----( Declare Constants and Pin Numbers )-----*/
#define CE_PIN   9
#define CSN_PIN 10

#define JOYSTICK_X A0
#define JOYSTICK_Y A1
#define a1 3
#define a2 6
#define b1 5
#define b2 11
#define echoPin 7 // Echo Pin
#define trigPin 8 // Trigger Pin
#define buzzer
int LED = 2;
int stateLED = LOW;
int stateButton;
int previous = LOW;
long time = 0;
long debounce = 200;
int maximumRange = 200; // Maximum range needed
int minimumRange = 0; // Minimum range needed
long duration, distance; // Duration used to calculate distance
const uint64_t pipe = 0xE8E8F0F0E1LL; // Define the transmit pipe


/*-----( Declare objects )-----*/
RF24 radio(CE_PIN, CSN_PIN); // Create a Radio
/*-----( Declare Variables )-----*/
int buttonState=0;
int joystick[4];
int val;
void setup()   /****** SETUP: RUNS ONCE ******/
{
  pinMode(a1,OUTPUT);
  pinMode(a2,OUTPUT);
  pinMode(b1,OUTPUT);
  pinMode(b2,OUTPUT);
  pinMode(LED, OUTPUT);
  pinMode(trigPin, OUTPUT);
  pinMode(echoPin, INPUT);
  Serial.begin(9600);
  delay(1000);
  Serial.println("Nrf24L01 Receiver Starting");
  radio.begin();
  radio.openReadingPipe(1,pipe);
  radio.startListening();
}//--(end setup )---
 


void loop()   /****** LOOP: RUNS CONSTANTLY ******/
{
  while(radio.available())
  {
    radio.read(&joystick,sizeof(joystick));
    stateButton = joystick[2];  
    if(stateButton == HIGH && previous == LOW && millis() - time > debounce) {
    if(stateLED == HIGH){
      stateLED = LOW; 
    } else {
       stateLED = HIGH; 
    }
    time = millis();
  }
  digitalWrite(LED, stateLED);
  previous == stateButton;

  
 digitalWrite(trigPin, LOW); 
 delayMicroseconds(2); 
 digitalWrite(trigPin, HIGH);
 delayMicroseconds(10); 
 digitalWrite(trigPin, LOW);
 duration = pulseIn(echoPin, HIGH);
 distance = duration/58.2;
 Serial.println(distance);
 if(distance>=5){
   
   Serial.println(joystick[0]);
   Serial.println(joystick[1]);
   if((joystick[0]==502||joystick[0]==503)&&joystick[1]==507)//center
   {
      digitalWrite(a1,LOW);
      digitalWrite(a2,LOW);
      digitalWrite(b1,LOW);
      digitalWrite(b2,LOW);
   }
   if(joystick[0]<=502&&joystick[1]>=507)//left
   {
      val=map(joystick[0],502,2,0,255);
      digitalWrite(a1,0);
      analogWrite(a2,val);
      analogWrite(b1,val);
      digitalWrite(b2,0);
   }
   if(joystick[0]>=502&&joystick[1]>=506)//righ
   {
      val=map(joystick[0],502,1020,0,255);
      analogWrite(a1,val);
      analogWrite(a2,0);
      analogWrite(b1,0); 
      analogWrite(b2,val);
   }
    if((joystick[0]==502||joystick[0]==503)&&joystick[1]>507)//forward
   {
      val=map(joystick[1],507,1020,0,255);
      analogWrite(a1,val);
      analogWrite(a2,0);
      analogWrite(b1,val);
      analogWrite(b2,0);
   }

   if(joystick[0]==502&&joystick[1]<507)//backwards
   {
      val=map(joystick[1],507,2,0,255);
      analogWrite(a1,0);
      analogWrite(a2,val);
      analogWrite(b1,0);
      analogWrite(b2,val);
   }
  
  }
  else{
    digitalWrite(a1,LOW);
    digitalWrite(a2,LOW);
    digitalWrite(b1,LOW);
    digitalWrite(b2,LOW);
   // tone(13, 1500, 1500);
    delay(1000);
    digitalWrite(a2,HIGH);
    digitalWrite(b2,HIGH);
    delay(1000);
    digitalWrite(a1,LOW);
    digitalWrite(a2,LOW);
    digitalWrite(b1,LOW);
    digitalWrite(b2,LOW);
    
  }
  }
  
}
